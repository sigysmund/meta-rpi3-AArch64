## conf/layer.conf
```bitbake
# We have a conf and classes directory, add to BBPATH
BBPATH .= ":${LAYERDIR}"

# We have recipes-* directories, add to BBFILES
BBFILES += "${LAYERDIR}/recipes-*/*/*.bb \
	${LAYERDIR}/recipes-*/*/*.bbappend"

BBFILE_COLLECTIONS += "rpi3-AArch64"
BBFILE_PATTERN_rpi3-AArch64 = "^${LAYERDIR}/"
BBFILE_PRIORITY_rpi3-AArch64 = "10"

LAYERDEPENDS_rpi3-aarch64 = "raspberrypi"
```

## conf/machine/raspberrypi3-64.conf
```bitbake
#@TYPE: Machine
#@NAME: RaspberryPi 3 Development Board
#@DESCRIPTION: Machine configuration for the Raspberry Pi Model 3

MACHINEOVERRIDES = "raspberrypi3:${MACHINE}"

MACHINE_EXTRA_RRECOMMENDS += "linux-firmware-brcm43430"
TARGET_FPU = "hard"

PREFERRED_VERSION_linux-raspberrypi ?= "4.10.%"

SDIMG_KERNELIMAGE_raspberrypi3 ?= "kernel8.img"
KERNEL_DEVICETREE = " \
	broadcom/bcm2710-rpi-3-b.dtb \
    "

RPIFW_SRCREV ?= "ad8608c08b122b2c228dba0ff5070d6e9519faf5"
RPIFW_DATE ?= "20160921"

TUNE_CCARGS ?= "-mtune=cortex-a53"

require conf/machine/include/arm/arch-armv8.inc
include conf/machine/include/rpi-base.inc
```
